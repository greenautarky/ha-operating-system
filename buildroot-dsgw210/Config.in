## buildroot-dsgw210/Config.in
```kconfig
source "$BR2_EXTERNAL_DSGW210_PATH/package/dsgw210-led/Config.in"
source "$BR2_EXTERNAL_DSGW210_PATH/package/ga-wlan-platdata/Config.in"
```

## buildroot-dsgw210/configs/dsgw210_defconfig
```kconfig
BR2_aarch64=y
BR2_PACKAGE_HOST_LINUX_HEADERS_CUSTOM_6_12=y
BR2_TOOLCHAIN_BUILDROOT_CXX=y
BR2_DL_DIR="/cache/dl"
BR2_CCACHE=y
BR2_CCACHE_DIR="/cache/cc"
BR2_ENABLE_LTO=y
BR2_GLOBAL_PATCH_DIR="$(BR2_EXTERNAL_DSGW210_PATH)/patches-haos $(BR2_EXTERNAL_GA_HAOS_PATH)/patches $(BR2_EXTERNAL_DSGW210_PATH)/board/dusun/dsgw210/patches"
BR2_PACKAGE_OVERRIDE_FILE="$(BR2_EXTERNAL_DSGW210_PATH)/local.mk"
BR2_SSP_REGULAR=y
BR2_TARGET_GENERIC_HOSTNAME="homeassistant"
BR2_TARGET_GENERIC_ISSUE="Welcome to Home Assistant"
BR2_INIT_SYSTEMD=y
# BR2_TARGET_GENERIC_REMOUNT_ROOTFS_RW is not set
BR2_TARGET_LOCALTIME=""
BR2_ROOTFS_OVERLAY="$(BR2_EXTERNAL_HAOS_PATH)/rootfs-overlay $(BR2_EXTERNAL_GA_HAOS_PATH)/rootfs-overlay $(BR2_EXTERNAL_DSGW210_PATH)/board/dusun/dsgw210/rootfs-overlay"
# Permission table — forces the LTE NM keyfile to 0600 (git/overlay can
# only carry 0644, and NetworkManager rejects insecure keyfiles).
BR2_ROOTFS_DEVICE_TABLE="system/device_table.txt $(BR2_EXTERNAL_DSGW210_PATH)/board/dusun/dsgw210/lte-permissions.txt"
BR2_ROOTFS_POST_BUILD_SCRIPT="$(BR2_EXTERNAL_HAOS_PATH)/scripts/post-build.sh $(BR2_EXTERNAL_GA_HAOS_PATH)/scripts/post-build.sh"
BR2_ROOTFS_POST_IMAGE_SCRIPT="$(BR2_EXTERNAL_HAOS_PATH)/scripts/post-image.sh"
BR2_ROOTFS_POST_SCRIPT_ARGS="$(BR2_EXTERNAL_DSGW210_PATH)/board/dusun/dsgw210 $(BR2_EXTERNAL_DSGW210_PATH)/board/dusun/dsgw210/haos-hook.sh"
BR2_LINUX_KERNEL=y
BR2_LINUX_KERNEL_CUSTOM_VERSION=y
BR2_LINUX_KERNEL_CUSTOM_VERSION_VALUE="6.18.54"
BR2_LINUX_KERNEL_USE_CUSTOM_CONFIG=y
BR2_LINUX_KERNEL_CUSTOM_CONFIG_FILE="$(BR2_EXTERNAL_HAOS_PATH)/kernel/v6.18.y/kernel-arm64-rockchip.config"
BR2_LINUX_KERNEL_CONFIG_FRAGMENT_FILES="$(BR2_EXTERNAL_HAOS_PATH)/kernel/v6.18.y/haos.config $(BR2_EXTERNAL_HAOS_PATH)/kernel/v6.18.y/docker.config $(BR2_EXTERNAL_HAOS_PATH)/kernel/v6.18.y/device-support.config $(BR2_EXTERNAL_HAOS_PATH)/kernel/v6.18.y/device-support-wireless.config $(BR2_EXTERNAL_DSGW210_PATH)/board/dusun/dsgw210/kernel.config"
BR2_LINUX_KERNEL_LZ4=y
BR2_LINUX_KERNEL_DTS_SUPPORT=y
BR2_LINUX_KERNEL_INTREE_DTS_NAME="rockchip/rk3328-dsgw210"
BR2_LINUX_KERNEL_CUSTOM_DTS_DIR="$(BR2_EXTERNAL_DSGW210_PATH)/board/dusun/dsgw210/dts"
BR2_LINUX_KERNEL_DTB_OVERLAY_SUPPORT=y
BR2_LINUX_KERNEL_NEEDS_HOST_OPENSSL=y
BR2_LINUX_KERNEL_NEEDS_HOST_LIBELF=y
BR2_PACKAGE_BUSYBOX_CONFIG="$(BR2_EXTERNAL_HAOS_PATH)/busybox.config"
BR2_PACKAGE_BUSYBOX_INDIVIDUAL_BINARIES=y
BR2_PACKAGE_V4L2LOOPBACK=y
BR2_PACKAGE_PIGZ=y
BR2_PACKAGE_JQ=y
BR2_PACKAGE_CIFS_UTILS=y
BR2_PACKAGE_DOSFSTOOLS=y
BR2_PACKAGE_DOSFSTOOLS_FSCK_FAT=y
BR2_PACKAGE_E2FSPROGS_E2IMAGE=y
BR2_PACKAGE_NFS_UTILS=y
# BR2_PACKAGE_NFS_UTILS_RPC_NFSD is not set
# Firmware: the board needs exactly one linux-firmware blob, the onboard
# RTL8821CS Wi-Fi (rtw88 loads rtw88/rtw8821c_fw.bin). Zigbee, Bluetooth,
# Z-Wave and LTE sit behind EFR32 / ZGM130S / BG96 chips on UART or
# USB-serial and carry their firmware on-chip. The rest of the generic HAOS
# set (RTW89, Broadcom/Cypress, Realtek BT dongles such as the RTL8761CU,
# the USB Wi-Fi dongle blobs) is for chips this board does not have.
BR2_PACKAGE_LINUX_FIRMWARE=y
BR2_PACKAGE_LINUX_FIRMWARE_RTL_RTW88=y
BR2_PACKAGE_DBUS_BROKER=y
BR2_PACKAGE_GPTFDISK=y
BR2_PACKAGE_GPTFDISK_SGDISK=y
# BR2_PACKAGE_LVM2_STANDARD_INSTALL is not set
BR2_PACKAGE_USB_MODESWITCH_DATA=y
BR2_PACKAGE_CA_CERTIFICATES=y
BR2_PACKAGE_LIBCURL_CURL=y
BR2_PACKAGE_LIBDNET=y
BR2_PACKAGE_LIBCGROUP=y
BR2_PACKAGE_LIBCGROUP_TOOLS=y
BR2_PACKAGE_BLUEZ5_UTILS=y
BR2_PACKAGE_BLUEZ5_UTILS_CLIENT=y
BR2_PACKAGE_BLUEZ5_UTILS_TOOLS=y
BR2_PACKAGE_BLUEZ5_UTILS_DEPRECATED=y
BR2_PACKAGE_BLUEZ5_UTILS_PLUGINS_AUDIO=y
BR2_PACKAGE_BLUEZ5_UTILS_PLUGINS_HID=y
BR2_PACKAGE_DHCP=y
BR2_PACKAGE_DHCP_CLIENT=y
# BR2_PACKAGE_IFUPDOWN_SCRIPTS is not set
BR2_PACKAGE_IPROUTE2=y
BR2_PACKAGE_IPTABLES_NFTABLES=y
BR2_PACKAGE_IPTABLES_NFTABLES_DEFAULT=y
BR2_PACKAGE_NETWORK_MANAGER=y
BR2_PACKAGE_NETWORK_MANAGER_CLI=y
BR2_PACKAGE_NETWORK_MANAGER_MODEM_MANAGER=y
BR2_PACKAGE_NETWORK_MANAGER_PPPD=y
BR2_PACKAGE_RPCBIND=y
BR2_PACKAGE_WIRELESS_REGDB=y
BR2_PACKAGE_WPA_SUPPLICANT=y
BR2_PACKAGE_WPA_SUPPLICANT_WEXT=y
BR2_PACKAGE_WPA_SUPPLICANT_AP_SUPPORT=y
BR2_PACKAGE_WPA_SUPPLICANT_WPA3=y
BR2_PACKAGE_WPA_SUPPLICANT_DBUS=y
BR2_PACKAGE_WPA_SUPPLICANT_DBUS_INTROSPECTION=y
BR2_PACKAGE_APPARMOR=y
BR2_PACKAGE_APPARMOR_PROFILES=y
BR2_PACKAGE_TINI=y
BR2_PACKAGE_AUDIT=y
BR2_PACKAGE_DOCKER_CLI=y
BR2_PACKAGE_DOCKER_ENGINE=y
BR2_PACKAGE_PROCPS_NG=y
BR2_PACKAGE_LIBOPENSSL_ENGINES=y
BR2_PACKAGE_LIBOPENSSL_DYNAMIC_ENGINE=y
BR2_PACKAGE_RAUC=y
BR2_PACKAGE_RAUC_DBUS=y
BR2_PACKAGE_RAUC_NETWORK=y
BR2_PACKAGE_SYSTEMD_JOURNAL_REMOTE=y
BR2_PACKAGE_SYSTEMD_COREDUMP=y
# BR2_PACKAGE_SYSTEMD_HWDB is not set
BR2_PACKAGE_SYSTEMD_LOCALED=y
BR2_PACKAGE_SYSTEMD_LOGIND=y
# BR2_PACKAGE_SYSTEMD_NETWORKD is not set
BR2_PACKAGE_SYSTEMD_RANDOMSEED=y
BR2_PACKAGE_SYSTEMD_VCONSOLE_DEFAULT_KEYMAP=""
BR2_PACKAGE_UTIL_LINUX_LIBFDISK=y
BR2_PACKAGE_UTIL_LINUX_LOGIN=y
BR2_PACKAGE_UTIL_LINUX_NOLOGIN=y
BR2_PACKAGE_UTIL_LINUX_PARTX=y
BR2_PACKAGE_UTIL_LINUX_ZRAMCTL=y
# LTE: Quectel BG96 via ModemManager + NetworkManager (gsm connection).
# NETWORK_MANAGER_MODEM_MANAGER/_PPPD (above) pull in modem-manager,
# mobile-broadband-provider-info and pppd. The BG96 is an AT+PPP modem
# (no QMI/MBIM net device), so NM dials it through pppd.
BR2_PACKAGE_PPPD=y
# RTL8821CS power-on / late SDIO-rescan OOT module
BR2_PACKAGE_GA_WLAN_PLATDATA=y
# TM1929 RGB indicator control tool
BR2_PACKAGE_DSGW210_LED=y
BR2_TARGET_UBOOT=y
BR2_TARGET_UBOOT_BUILD_SYSTEM_KCONFIG=y
BR2_TARGET_UBOOT_CUSTOM_VERSION=y
BR2_TARGET_UBOOT_CUSTOM_VERSION_VALUE="2026.04"
BR2_TARGET_UBOOT_BOARD_DEFCONFIG="rock64-rk3328"
BR2_TARGET_UBOOT_CONFIG_FRAGMENT_FILES="$(BR2_EXTERNAL_HAOS_PATH)/bootloader/uboot.config $(BR2_EXTERNAL_DSGW210_PATH)/board/dusun/dsgw210/uboot.config"
BR2_TARGET_UBOOT_NEEDS_DTC=y
BR2_TARGET_UBOOT_NEEDS_PYLIBFDT=y
BR2_TARGET_UBOOT_NEEDS_PYELFTOOLS=y
BR2_TARGET_UBOOT_NEEDS_OPENSSL=y
BR2_TARGET_UBOOT_NEEDS_ATF_BL31=y
BR2_TARGET_UBOOT_NEEDS_ATF_BL31_ELF=y
BR2_TARGET_UBOOT_NEEDS_TPL=y
BR2_TARGET_UBOOT_FORMAT_CUSTOM=y
BR2_TARGET_UBOOT_FORMAT_CUSTOM_NAME="u-boot-rockchip.bin"
BR2_TARGET_ARM_TRUSTED_FIRMWARE=y
BR2_TARGET_ARM_TRUSTED_FIRMWARE_PLATFORM="rk3328"
BR2_TARGET_ARM_TRUSTED_FIRMWARE_BL31=y
BR2_TARGET_ARM_TRUSTED_FIRMWARE_IMAGES=""
BR2_PACKAGE_ROCKCHIP_BLOBS=y
BR2_PACKAGE_ROCKCHIP_BLOBS_VERSION="ada021aa0643c69e0ecf0e54b70b02ee801b1375"
BR2_PACKAGE_ROCKCHIP_BLOBS_TPL="bin/rk33/rk3328_ddr_333MHz_v1.22.bin"
BR2_PACKAGE_HOST_DOSFSTOOLS=y
BR2_PACKAGE_HOST_E2FSPROGS=y
BR2_PACKAGE_HOST_GENIMAGE=y
BR2_PACKAGE_HOST_GPTFDISK=y
BR2_PACKAGE_HOST_MTOOLS=y
BR2_PACKAGE_HOST_RAUC=y
BR2_PACKAGE_HOST_TEMPIO=y
BR2_PACKAGE_HOST_UBOOT_TOOLS=y
BR2_PACKAGE_HOST_UBOOT_TOOLS_BOOT_SCRIPT=y
BR2_PACKAGE_HOST_UBOOT_TOOLS_BOOT_SCRIPT_SOURCE="$(BR2_EXTERNAL_DSGW210_PATH)/board/dusun/dsgw210/uboot-boot.ush"
# Root filesystem: erofs (read-only, deduplicated, LZ4HC). HAOS standard.
BR2_TARGET_ROOTFS_EROFS=y
BR2_TARGET_ROOTFS_EROFS_LZ4HC_LEVEL=12
BR2_TARGET_ROOTFS_EROFS_DEDUPE=y
BR2_TARGET_ROOTFS_EROFS_FRAGMENTS=y
BR2_TARGET_ROOTFS_EROFS_ZTAILPACKING=y
BR2_TARGET_ROOTFS_EROFS_PCLUSTERSIZE=262144
# BR2_TARGET_ROOTFS_TAR is not set
BR2_PACKAGE_UDISKS2=y
BR2_PACKAGE_HASSIO=y
BR2_PACKAGE_HASSIO_ARCH="aarch64"
BR2_PACKAGE_HASSIO_MACHINE="qemuarm-64"
BR2_PACKAGE_OS_AGENT=y
BR2_PACKAGE_OS_AGENT_BOARD="DSGW-210"
# --- GreenAutarky OS layer (GA_HAOS external) ---------------------------------
# Packages the GA layer needs: telemetry, mesh VPN, OpenSSH for the ADR-0019
# SSH plane (replaces dropbear), nftables (ga-firewall), the openssl CLI (GA
# HMAC derivation), sulogin (ga-root-shadow emergency/rescue), xz.
BR2_PACKAGE_FLUENT_BIT=y
BR2_PACKAGE_FLUENT_BIT_CONFIG=y
BR2_PACKAGE_NETBIRD=y
BR2_PACKAGE_TELEGRAF=y
BR2_PACKAGE_OPENSSH=y
BR2_PACKAGE_OPENSSH_CLIENT=y
BR2_PACKAGE_OPENSSH_SERVER=y
BR2_PACKAGE_OPENSSH_KEY_UTILS=y
BR2_PACKAGE_NFTABLES=y
BR2_PACKAGE_LIBOPENSSL_BIN=y
BR2_PACKAGE_UTIL_LINUX_SULOGIN=y
BR2_PACKAGE_XZ=y
BR2_PACKAGE_BUSYBOX_CONFIG_FRAGMENT_FILES="$(BR2_EXTERNAL_GA_HAOS_PATH)/busybox-ga.fragment"
```

## buildroot-dsgw210/package/dsgw210-led/Config.in
```kconfig
config BR2_PACKAGE_DSGW210_LED
	bool "dsgw210-led (dsgw-led: TM1929 status-LED ring daemon)"
	depends on BR2_aarch64
	help
	  Status-LED daemon + client for the Dusun DSGW-210 front ring:
	  6 RGB LEDs on a Titan Micro TM1929 at I2C 0x23 on /dev/i2c-0
	  (no kernel driver, no DT node; the chip is driven from
	  userspace like Dusun's own `dsled`).

	    dsgw-led daemon | set "<Option>" | get | list | selftest

	  Option names are the iHost hardware-control add-on's
	  ("Solid Red", "Marquee Red", "Breathing Blue", ...). Installed
	  as a static binary at /usr/bin/dsgw-led; the systemd units live
	  in the dsgw210 board rootfs-overlay.

comment "dsgw210-led needs an aarch64 toolchain"
	depends on !BR2_aarch64
```

## buildroot-dsgw210/package/ga-wlan-platdata/Config.in
```kconfig
config BR2_PACKAGE_GA_WLAN_PLATDATA
	bool "ga-wlan-platdata (RTL8821CS power-on/rescan OOT module)"
	depends on BR2_LINUX_KERNEL
	depends on BR2_aarch64
	help
	  Out-of-tree kernel module that mimics the Rockchip 4.4 BSP
	  rfkill-wlan + rp_gpio behaviour against the mainline 6.x kernel.

	  Binds to the `greenautarky,wlan-platdata` / `rockchip,wlan-platdata`
	  device-tree node, drives WL_REG_ON LOW->HIGH with BSP-style timing,
	  enables the RK805 32 kHz LPO ext_clock, and triggers an SDIO rescan
	  on the parent mmc-host phandle.

	  Required for RTL8821CS WiFi enumeration on the Dusun DSGW-210
	  (RK3328) under mainline kernels. The chip is silent under mainline's
	  stock dwmmc-rockchip + mmc-pwrseq-simple flow; the BSP-equivalent
	  late-rescan path supplied by this module is the working substitute.

comment "ga-wlan-platdata needs a Linux kernel + aarch64 toolchain"
	depends on !BR2_LINUX_KERNEL || !BR2_aarch64
```

## buildroot-external/package/ga-vibe-addons/Config.in
```kconfig
config BR2_PACKAGE_GA_VIBE_ADDONS
	bool "ga-vibe-addons (vendored Greenautarky addon repo snapshot)"
	default y
	help
	  Clones the public greenautarky/vibe_addons addon repository at
	  build time and vendors a snapshot (with .git) into the rootfs at
	  /usr/share/ga/vibe_addons/.

	  ga-bootstrap copies this to the writable data partition on first
	  boot (/mnt/data/supervisor/ga-vibe-addons/, visible to the
	  Supervisor at /data/ga-vibe-addons/) and registers it with the
	  Supervisor as a `file:///data/ga-vibe-addons` store repo. That
	  makes first-boot addon install offline-deterministic, pins the
	  addon-set to the OS release (no `vibe_addons` HEAD drift), and
	  leaves the URL stable for ga_manager-driven future updates
	  (`git fetch origin` inside the writable copy + `ha store reload`).
```
