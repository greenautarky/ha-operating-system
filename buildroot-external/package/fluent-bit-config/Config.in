## buildroot-external/package/fluent-bit-config/Config.in
```kconfig
config BR2_PACKAGE_FLUENT_BIT_CONFIG
    bool "Fluent Bit config + systemd integration"
    select BR2_PACKAGE_FLUENT_BIT
    help
      Install systemd service and default config for Fluent Bit on iHost/HAOS.
```

## buildroot-external/package/netbird/Config.in
```kconfig
config BR2_PACKAGE_NETBIRD
    bool "netbird (WireGuard mesh VPN)"
    depends on BR2_PACKAGE_HOST_GO_TARGET_ARCH_SUPPORTS
    depends on BR2_TOOLCHAIN_HAS_THREADS
    depends on BR2_USE_MMU
    help
      NetBird client/agent (CLI + daemon service).
      https://github.com/netbirdio/netbird
```

## buildroot-external/package/telegraf/Config.in
```kconfig
config BR2_PACKAGE_TELEGRAF
    bool "telegraf"
    depends on BR2_PACKAGE_HOST_GO_TARGET_ARCH_SUPPORTS
    depends on BR2_PACKAGE_HOST_GO_TARGET_CGO_LINKING_SUPPORTS
    depends on BR2_TOOLCHAIN_HAS_THREADS
    depends on BR2_USE_MMU   # for logrotate
    depends on BR2_USE_WCHAR # for logrotate
    select BR2_PACKAGE_LOGROTATE
    help
      Telegraf metrics agent (InfluxData).
      https://github.com/influxdata/telegraf
```
